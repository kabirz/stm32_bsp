## boards/apollo_f767ig/Kconfig.defconfig
```kconfig
# STM32F767ZI Nucleo board configuration

# Copyright (c) 2019 Roland Ma
# SPDX-License-Identifier: Apache-2.0

if BOARD_APOLLO_F767IG

if NETWORKING

config NET_L2_ETHERNET
	default y

endif # NETWORKING

endif # BOARD_APOLLO_F767IG
```

## boards/apollo_f767ig/apollo_f767ig_defconfig
```kconfig
# SPDX-License-Identifier: Apache-2.0

# Enable MPU
CONFIG_ARM_MPU=y

# Enable HW stack protection
CONFIG_HW_STACK_PROTECTION=y

# Enable UART
CONFIG_SERIAL=y

# Console
CONFIG_CONSOLE=y
CONFIG_UART_CONSOLE=y

# Enable GPIO
CONFIG_GPIO=y

# enable log
CONFIG_LOG=y

# rtt
CONFIG_USE_SEGGER_RTT=y

# shell 
CONFIG_SHELL=y
CONFIG_SHELL_BACKEND_RTT=y
CONFIG_SHELL_BACKEND_SERIAL=y
CONFIG_SHELL_VT100_COLORS=y
CONFIG_SHELL_TAB=y
CONFIG_SHELL_VT100_COMMANDS=y

# networking
CONFIG_NETWORKING=y
CONFIG_TEST_RANDOM_GENERATOR=y
CONFIG_NET_CONNECTION_MANAGER=y
CONFIG_NET_MGMT_EVENT_MONITOR=y
CONFIG_ETH_DRIVER=y
CONFIG_NET_L2_ETHERNET=y
CONFIG_NET_ARP=y
CONFIG_NET_IPV4=y
CONFIG_NET_IPV4_IGMP=y
CONFIG_NET_SHELL=y
```

## boards/apollo_f767ig/board.yml
```yaml
board:
  name: apollo_f767ig
  full_name: apollo F767IG
  vendor: st
  socs:
    - name: stm32f767xx
```

## boards/apollo_h743ii/apollo_h743ii_defconfig
```kconfig
# SPDX-License-Identifier: Apache-2.0

# Enable MPU
CONFIG_ARM_MPU=y

# Enable HW stack protection
CONFIG_HW_STACK_PROTECTION=y

# Enable UART
CONFIG_SERIAL=y

# Enable flash
CONFIG_FLASH=y
CONFIG_FLASH_SHELL=y

# enable flash map
CONFIG_FLASH_MAP=y
CONFIG_FLASH_MAP_SHELL=y

# log
CONFIG_LOG=y
CONFIG_LOG_BUFFER_SIZE=2048

# file system
CONFIG_FILE_SYSTEM=y
CONFIG_FILE_SYSTEM_LITTLEFS=y
CONFIG_FILE_SYSTEM_SHELL=y
CONFIG_HEAP_MEM_POOL_SIZE=2048
CONFIG_MAIN_STACK_SIZE=2048

# Console
CONFIG_CONSOLE=y
CONFIG_UART_CONSOLE=y

# Enable GPIO
CONFIG_GPIO=y
CONFIG_LOG=y

# rtc
CONFIG_RTC=y
CONFIG_RTC_SHELL=y

#  RTT
CONFIG_USE_SEGGER_RTT=y

# RTT shell 
CONFIG_SHELL=y
CONFIG_SHELL_BACKEND_RTT=y
CONFIG_SHELL_BACKEND_SERIAL=y
CONFIG_SHELL_VT100_COLORS=y
CONFIG_SHELL_TAB=y
CONFIG_SHELL_VT100_COMMANDS=y

# networking
CONFIG_NETWORKING=y
CONFIG_TEST_RANDOM_GENERATOR=y
CONFIG_NET_CONNECTION_MANAGER=y
CONFIG_NET_MGMT_EVENT_MONITOR=y
CONFIG_ETH_DRIVER=y
CONFIG_NET_L2_ETHERNET=y
CONFIG_NET_ARP=y
CONFIG_NET_IPV4=y
CONFIG_NET_IPV4_IGMP=y
CONFIG_NET_SHELL=y

# settings
CONFIG_FCB=y
CONFIG_SETTINGS=y
```

## boards/daq_f407vet6/board.yml
```yaml
board:
  name: daq_f407vet6
  full_name: daq STM32 F407VET6 Development Board
  vendor: others
  socs:
    - name: stm32f407xx
```

## boards/daq_f407vet6/daq_f407vet6_defconfig
```kconfig
# SPDX-License-Identifier: Apache-2.0

# Enable MPU
CONFIG_ARM_MPU=y

# Enable HW stack protection
CONFIG_HW_STACK_PROTECTION=y

# Enable UART
CONFIG_SERIAL=y

# Console
CONFIG_CONSOLE=y
CONFIG_UART_CONSOLE=y

# Enable GPIO
CONFIG_GPIO=y


# Enable flash
CONFIG_FLASH=y
CONFIG_FLASH_SHELL=y
CONFIG_SPI_NOR_FLASH_LAYOUT_PAGE_SIZE=4096

# enable flash map
CONFIG_FLASH_MAP=y
CONFIG_FLASH_MAP_SHELL=y
CONFIG_LOG=y

# file system
CONFIG_FILE_SYSTEM=y
CONFIG_FILE_SYSTEM_LITTLEFS=y
CONFIG_FILE_SYSTEM_SHELL=y

#  RTT
CONFIG_USE_SEGGER_RTT=y

# RTT shell 
CONFIG_SHELL=y
CONFIG_SHELL_BACKEND_RTT=y
CONFIG_SHELL_BACKEND_SERIAL=y
CONFIG_SHELL_VT100_COLORS=y
CONFIG_SHELL_TAB=y
CONFIG_SHELL_VT100_COMMANDS=y
CONFIG_NET_SHELL=y

# networking
CONFIG_NETWORKING=y
CONFIG_TEST_RANDOM_GENERATOR=y
CONFIG_NET_CONNECTION_MANAGER=y
CONFIG_NET_MGMT_EVENT_MONITOR=y
CONFIG_ETH_DRIVER=y
CONFIG_NET_L2_ETHERNET=y
CONFIG_NET_ARP=y
CONFIG_NET_IPV4=y
CONFIG_NET_IPV4_IGMP=y
# CONFIG_NET_IPV6 is not set
CONFIG_NET_CONFIG_SETTINGS=y
CONFIG_NET_CONFIG_MY_IPV4_ADDR="192.168.12.101"
CONFIG_NET_CONFIG_MY_IPV4_NETMASK="255.255.255.0"
CONFIG_NET_CONFIG_MY_IPV4_GW="192.168.12.1"

CONFIG_MAIN_STACK_SIZE=2048
CONFIG_RTC=y
CONFIG_RTC_SHELL=y
```

## boards/moni_f407vet6/Kconfig.defconfig
```kconfig
# daq_f407vet6 board configuration


if BOARD_MONI_F407VET6

config SPI_STM32_INTERRUPT
	default y
	depends on SPI

endif # BOARD_MONI_F407VET6
```

## boards/moni_f407vet6/board.yml
```yaml
board:
  name: moni_f407vet6
  full_name: moni STM32 F407VET6 Development Board
  vendor: others
  socs:
    - name: stm32f407xx
```

## boards/moni_f407vet6/moni_f407vet6_defconfig
```kconfig
# SPDX-License-Identifier: Apache-2.0

# Enable MPU
CONFIG_ARM_MPU=y

# Enable HW stack protection
CONFIG_HW_STACK_PROTECTION=y

# Enable UART
CONFIG_SERIAL=y

# Console
CONFIG_CONSOLE=y
CONFIG_UART_CONSOLE=y

# Enable GPIO
CONFIG_GPIO=y


# Enable flash
CONFIG_FLASH=y
CONFIG_FLASH_SHELL=y
CONFIG_SPI_NOR_FLASH_LAYOUT_PAGE_SIZE=4096

# enable flash map
CONFIG_FLASH_MAP=y
CONFIG_FLASH_MAP_SHELL=y
CONFIG_LOG=y

# file system
CONFIG_FILE_SYSTEM=y
CONFIG_FILE_SYSTEM_LITTLEFS=y
CONFIG_FILE_SYSTEM_SHELL=y
CONFIG_FILE_SYSTEM_SHELL_TEST_COMMANDS=y

#  RTT
CONFIG_USE_SEGGER_RTT=y

# RTT shell 
CONFIG_SHELL=y
CONFIG_SHELL_BACKEND_RTT=y
CONFIG_SHELL_BACKEND_SERIAL=y
CONFIG_SHELL_VT100_COLORS=y
CONFIG_SHELL_TAB=y
CONFIG_SHELL_VT100_COMMANDS=y
```

## boards/stm32f103_bluepill/stm32f103_bluepill_defconfig
```kconfig
# SPDX-License-Identifier: Apache-2.0

# CONFIG_SERIAL is not set
CONFIG_CONSOLE=y
# CONFIG_UART_CONSOLE is not set

# enable GPIO
CONFIG_GPIO=y

#  RTT
CONFIG_USE_SEGGER_RTT=y
CONFIG_RTT_CONSOLE=y
CONFIG_SEGGER_RTT_MAX_NUM_UP_BUFFERS=1
CONFIG_SEGGER_RTT_MAX_NUM_DOWN_BUFFERS=1

# RTT shell 
CONFIG_SHELL=y
CONFIG_SHELL_BACKEND_RTT=y
CONFIG_SHELL_VT100_COLORS=y
CONFIG_SHELL_TAB=y
CONFIG_SHELL_CMDS_RESIZE=y
CONFIG_SHELL_ECHO_STATUS=y
# CONFIG_SHELL_START_OBSCURED is not set
CONFIG_SHELL_VT100_COMMANDS=y
```
